/ {
    split_inputs {
        #address-cells = <1>;
        #size-cells = <0>;

        trackball: trackball@0 {
            compatible = "zmk,input-split";
            reg = <0>;
        };
    };

    trackball_listener: trackball_listener {
        compatible = "zmk,input-listener";
        status = "disabled";
        device = <&trackball>;
    };
};
