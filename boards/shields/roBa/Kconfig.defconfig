## boards/shields/roBa/Kconfig.defconfig
```kconfig
if SHIELD_ROBA_DONGLE

config ZMK_KEYBOARD_NAME
    default "ROG ORBIT PRO"

config ZMK_SPLIT_ROLE_CENTRAL
    default y

endif

if SHIELD_ROBA_DONGLE || SHIELD_ROBA_L || SHIELD_ROBA_R

config ZMK_SPLIT
    default y

endif
```
